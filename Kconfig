## Kconfig
```kconfig
#
# For a description of the syntax of this configuration file,
# see Linux's Documentation/kbuild/kconfig-language.txt.
#
mainmenu "Akaros/$SRCARCH Kernel Configuration"

# This is info, not a setable option.  Must make ARCH=arch to change.
config SRCARCH
	string
	option env="ARCH"

config 64BIT
	bool "64-bit kernel"
	default y
	help
	  Say yes to build a 64-bit kernel.  Must be 'y' for x86.

menuconfig RUN_INIT_SCRIPT
	bool "Run init script after boot"
	default n
	help
	  Run an init script after boot instead of dropping into the monitor

config INIT_SCRIPT_PATH_AND_ARGS
	depends on RUN_INIT_SCRIPT
	string "Path to init script, followed by its arguments."
	default /bin/init.sh
	help
	  Path to the init script run at boot time, followed by a space
	  separated list of arguments

source "kern/arch/$SRCARCH/Kconfig"

source "kern/src/net/Kconfig"

source "kern/drivers/Kconfig"

menu "Filesystems"

config KFS
	bool "KFS filesystem"
	default y
	help
	  KFS is an initramfs bundled into the kernel, and contains your root
	  filesystem.

config KFS_PATHS
	depends on KFS
	string "KFS/Initramfs paths"
	default kern/kfs
	help
	  Space separated list of paths to directories to bundle into KFS.
	  This will be your root filesystem.

config KFS_CPIO_BIN
	depends on KFS
	string "KFS CPIO helper"
	default ""
	help
	  This binary (relative to the root directory) will be run before
	  bundling the KFS Paths into the CPIO.

endmenu

choice COREALLOC_POLICY
	prompt "Core Allocation Policy"
	help
	  Select a policy for allocating cores to a process upon request.  All
	  strategies first allocate cores from the set of provisioned cores for
	  a process, but differ in how they select cores beyond this.

config COREALLOC_FCFS
	bool "Simple FCFS"
	help
	  Allocate cores to processes on a first-come-first-served basis. All
	  cores are treated equally, and no topology information is used to try
	  and optimize which cores are given to which processes upon request.

config COREALLOC_PACKED
	bool "Packed Topology"
	help
	  Allocate cores to a process based on a topology-aware algorithm that
	  tries to pack allocated cores as close together as possible.  It
	  first tries to pair new cores with their hyper-threaded pair, then
	  keep them on the same socket, then the same numa domain.

endchoice

menu "Kernel Debugging"

menu "Per-cpu Tracers"

config TRACE_KMSGS
	bool "KMSG Tracing"
	default n
	help
	  Turns on KMSG tracing, using the per-cpu ring buffer (holds about 256
	  events).  You can access this from the monitor via "trace pcpui".
	  Turn this off for a slight performance improvement on every KMSG (and
	  every MCP proc_yield).

config TRACE_LOCKS
	bool "Lock Tracing"
	depends on SPINLOCK_DEBUG
	default n
	help
	  Turns on lock tracing, using the per-cpu ring buffer.  This records
	  the a timestamp and lock address, in an over-write tracing style
	  (meaning it'll clobber older events).  If you have locking issues,
	  this may give you clues as to which locks were grabbed recently.

endmenu

config DEVELOPMENT_ASSERTIONS
	bool "dasserts"
	default n
	help
	  Turn on dassert() in code, dassert will compile to assert().

config SPINLOCK_DEBUG
	bool "Spinlock debugging"
	default n
	help
	  Turns on debugging, which tracks the last time a lock was acquired
	  and detects improper lock acquisition based on IRQ levels (e.g. using
	  spin_lock() in IRQ context).  This will slow down all lock
	  acquisitions.

config SEQLOCK_DEBUG
	bool "Seqlock debugging"
	default n
	help
	  Provides asserts to detect seqlock errors.  This will allow a
	  malicious userspace to trigger a panic in the kernel.

config SEMAPHORE_DEBUG
	bool "Semaphore debugging"
	default n
	help
	  Turns on debugging, which tracks the last time and location that a
	  semaphore was downed, and provides a linked list of all semaphores
	  that have waiters.  This will slow down all semaphore ups and downs.

config SEM_SPINWAIT
	bool "Semaphore spinwaiting"
	default n
	help
	  Turns on semaphore spinwaiting.  In lieu of intelligent Adaptive
	  Mutexes, busy semaphores will just spin for a while before fully
	  sleeping.

config SEM_SPINWAIT_NR_LOOPS
	int "Number of polls before sleeping"
	depends on SEM_SPINWAIT
	default 100
	help
	  How many times to poll a busy semaphore before going to sleep.

config DISABLE_SMT
	bool "Disables symmetric multithreading"
	default n
	help
	  Disables hyperthreading by telling the kernel to never give out even
	  numbered cores to MCPs.  This does not check to see if the threads
	  are in fact siblings, or if the target machine is hyperthreaded.

config PRINTK_NO_BACKSPACE
	bool "Printk with no backspace"
	default n
	help
	  One of the serial devices I was using a while back had issues
	  printing backspaces.  This was an old hack to deal with that.

config SYSCALL_STRING_SAVING
	bool "Syscall string saving"
	default n
	help
	  Kmallocs a small buffer for each syscall and attaches it to the
	  kthread, which can be viewed when debugging semaphores.  Individual
	  syscalls can save info in this buffer.

config BETTER_BACKTRACE
	bool "Better backtraces, less optimizations"
	default n
	help
	  The kernel uses the frame pointer and call stacks for backtraces.
	  Tail-call optimizations remove some of this information.  Say 'Y'
	  here to have better backtraces, at the expense of performance.

endmenu

menu "Misc/Old Options"

config ARSC_SERVER
	bool "Asynchronous remote syscalls"
	default n
	help
	  Code to run a syscall-server on a core.  A process can submit
	  syscalls and get the results asynchronously.  Hasn't been used in
	  years.  Say 'n' unless you want to play around.

# SPARC auto-selects this
config APPSERVER
	bool "Appserver"
	default n
	help
	  Old school I/O was through a remote machine.  Not sure if anyone uses
	  this anymore.

config SERIAL_IO
	bool "Serial IO"
	default n
	help
	  Like the appserver, serial I/O was an old attempt to process I/O on a
	  remote machine across the serial port.

config SINGLE_CORE
	bool "Single core"
	default n
	help
	  Have the kernel boot only a single core.  Can be useful for
	  debugging, but hasn't been used in years.

config BSD_ON_CORE0
	bool "BSD on core 0"
	default n
	help
	  This was an old joke.  Say 'n', since we can't simply #include <bsd>.

endmenu

source "kern/lib/Kconfig"

source "kern/src/ktest/Kconfig"
```

## kern/Kconfig.testing
```kconfig
menu "Testing"

menuconfig POSTBOOT_KERNEL_TESTING
    bool "Post-boot kernel testing"
    default n
    help
        Run unit tests for after the kernel has booted.

config TEST_ipi_sending
    depends on POSTBOOT_KERNEL_TESTING && X86
    bool "IPI sending test"
    default n
    help
        Run the ipi_sending test

config TEST_pic_reception
    depends on POSTBOOT_KERNEL_TESTING && X86
    bool "PIC reception test"
    default n
    help
        Run the pic_reception

config TEST_ioapic_pit_reroute 
    depends on POSTBOOT_KERNEL_TESTING && X86
    bool "IOAPIC PIT reroute test"
    default n
    help
        Run the ioapic_pit_reroute test

config TEST_lapic_status_bit
    depends on POSTBOOT_KERNEL_TESTING && X86
    bool "LAPIC status bit test"
    default n
    help
        Run the lapic_status_bit

config TEST_pit
    depends on POSTBOOT_KERNEL_TESTING && X86
    bool "PIT test"
    default n
    help
        Run the pit test

config TEST_circ_buffer
    depends on POSTBOOT_KERNEL_TESTING && X86
    bool "Circular buffer test"
    default n
    help
        Run the circ_buffer test

config TEST_kernel_messages
    depends on POSTBOOT_KERNEL_TESTING && X86
    bool "Kernel messages test"
    default n
    help
        Run the kernel_messages test

config TEST_page_coloring
    depends on POSTBOOT_KERNEL_TESTING && PAGE_COLORING
    bool "Page coloring test"
    default n
    help
        Run the page_coloring test

config TEST_color_alloc
    depends on POSTBOOT_KERNEL_TESTING && PAGE_COLORING
    bool "Color allocation test"
    default n
    help
        Run the color_alloc test

config TEST_print_info
    depends on POSTBOOT_KERNEL_TESTING
    bool "Print info test"
    default n
    help
        Run the print_info test

config TEST_barrier
    depends on POSTBOOT_KERNEL_TESTING
    bool "Barrier test"
    default n
    help
        Run the barrier test

config TEST_interrupts_irqsave
    depends on POSTBOOT_KERNEL_TESTING
    bool "Interrupts irqsave test"
    default y
    help
        Run the interrupts_irqsave test

config TEST_bitmasks
    depends on POSTBOOT_KERNEL_TESTING
    bool "Bitmasks test"
    default y
    help
        Run the bitmasks test

config TEST_checklists
    depends on POSTBOOT_KERNEL_TESTING
    bool "Checklists test"
    default n
    help
        Run the checklists test

config TEST_smp_call_functions
    depends on POSTBOOT_KERNEL_TESTING
    bool "SMP call functions test"
    default n
    help
        Run the smp_call_functions test

config TEST_slab
    depends on POSTBOOT_KERNEL_TESTING
    bool "Slab test"
    default n
    help
        Run the slab test

config TEST_kmalloc
    depends on POSTBOOT_KERNEL_TESTING
    bool "Kmalloc test"
    default n
    help
        Run the kmalloc test

config TEST_hashtable
    depends on POSTBOOT_KERNEL_TESTING
    bool "Hashtable test"
    default y
    help
        Run the hashtable test

config TEST_bcq
    depends on POSTBOOT_KERNEL_TESTING
    bool "BCQ test"
    default n
    help
        Run the bcq test

config TEST_ucq
    depends on POSTBOOT_KERNEL_TESTING
    bool "UCQ test"
    default n
    help
        Run the ucq test

config TEST_vm_regions
    depends on POSTBOOT_KERNEL_TESTING
    bool "VM regions test"
    default y
    help
        Run the vm_regions test

config TEST_radix_tree
    depends on POSTBOOT_KERNEL_TESTING
    bool "Radix Tree test"
    default y
    help
        Run the radix_tree test

config TEST_random_fs
    depends on POSTBOOT_KERNEL_TESTING
    bool "Random FS test"
    default n
    help
        Run the random_fs test

config TEST_kthreads
    depends on POSTBOOT_KERNEL_TESTING
    bool "Kthreads test"
    default n
    help
        Run the kthreads test

config TEST_kref
    depends on POSTBOOT_KERNEL_TESTING
    bool "Kref test"
    default n
    help
        Run the kref test

config TEST_atomics
    depends on POSTBOOT_KERNEL_TESTING
    bool "Atomics test"
    default y
    help
        Run the atomics test

config TEST_abort_halt
    depends on POSTBOOT_KERNEL_TESTING
    bool "Abort halt test"
    default n
    help
        Run the abort_halt test

config TEST_cv
    depends on POSTBOOT_KERNEL_TESTING
    bool "Condition Variable test"
    default n
    help
        Run the cv test

config TEST_memset
    depends on POSTBOOT_KERNEL_TESTING
    bool "Memset test"
    default y
    help
        Run the memset test

config TEST_setjmp
    depends on POSTBOOT_KERNEL_TESTING
    bool "Setjmp test"
    default n
    help
        Run the setjmp test

config TEST_apipe
    depends on POSTBOOT_KERNEL_TESTING
    bool "Apipe test"
    default n
    help
        Run the apipe test

config TEST_rwlock
    depends on POSTBOOT_KERNEL_TESTING
    bool "Rwlock test"
    default n
    help
        Run the rwlock test

config TEST_rv
    depends on POSTBOOT_KERNEL_TESTING
    bool "Rendezvous test"
    default n
    help
        Run the rv test

config TEST_alarm
    depends on POSTBOOT_KERNEL_TESTING
    bool "Alarm test"
    default n
    help
        Run the alarm test

menuconfig USERSPACE_TESTING
    bool "User-space testing"
    default n
    help
        Run userspace unit tests after the kernel has booted.

config USERSPACE_TESTING_SCRIPT
    depends on USERSPACE_TESTING
    string "Path to test launcher script."
    default fill/me/in
    help
        Run userspace unit tests from the specified path. 

endmenu
```

## kern/arch/x86/Kconfig
```kconfig
config X86
	select 64BIT
	def_bool y

config X86_64
	def_bool 64BIT

menu "x86 Options"

config PCI_VERBOSE
	bool "Verbose PCI Output"
	default n
	help
	  Will print out extra information related to PCI.

config NOFASTCALL_FSBASE
	depends on X86_64
	bool "Disable fastcall to set FS base"
	default n
	help
	  Disable the fast path syscall to set FS base.  If your hardware
	  allows setting FS base from userspace, you can say y to disable the
	  fastcall for a slight improvement for all syscalls.  If unsure, say
	  n.

endmenu

menu "x86 Hacks"

config LOUSY_LAPIC_TIMER
	bool "Lousy Local APIC Timer"
	default n
	help
	  This turns our one-shot APIC timer into a periodic timer.  If your
	  system seems to lock up until you hit the keyboard, say 'Y' here and
	  report the results.

	  Qemu without KVM had issues firing a one-shot LAPIC timer (the timer
	  IRQ would only go off when some other IRQ fired), but it worked with
	  a periodic tick.  Since we aggressively disarm the timer, this config
	  shouldn't be a performance hit.

config NOMTRRS
	bool "Disable MTRRs"
	default y
	help
	  Old debug option from when we were having issues with MTRRs.  If your
	  machine won't boot, try turning this on.

config KB_CORE0_ONLY
	bool "Keyboard from core0 only"
	default n
	help
	  Say 'n' unless you are using a buggy x86 machine that can't handle
	  polling the keyboard PIO from cores other than core 0.

config X86_DISABLE_KEYBOARD
	bool "Disable Keyboard"
	default n
	help
	  x86 machines with a legacy USB keyboard often implement the USB stack
	  in SMM mode.  When doing anything with the keyboard, including
	  polling the keyboard from the kernel monitor, SMM mode can
	  dramatically interfere with other cores (like a 10-15x performance
	  impact on some benchmarks).

	  Say 'y' if you have such a machine and do not need the keyboard.

config ENABLE_LEGACY_USB
	bool "Enable Legacy USB"
	default n
	help
	  Say 'y' if you want to use a USB keyboard.  Given that we do not have
	  a USB stack, disabling legacy USB means USB keyboards will not work.
	  We disable legacy USB by default, since our primary console
	  communication is serial, and legacy USB support results in SMM
	  interference that affects all cores.

endmenu
```

## kern/drivers/Kconfig
```kconfig
menu "Drivers"

source "kern/drivers/net/Kconfig"
source "kern/drivers/dev/Kconfig"

endmenu
```

## kern/drivers/dev/Kconfig
```kconfig
config REGRESS
        bool "Include the regression test device"
        default y
        help
	  The regression test device allows you to push commands to monitor()
	  for testing. Defaults to 'y' for now.

config DEVVARS
	bool "#vars kernel variable exporter"
	default y
	help
	  The #vars device exports read access to select kernel variables.

config DEVVARS_TEST
	bool "#vars test files"
	depends on DEVVARS
	default n
	help
	  Have #vars include a collection of test files that devvars utest
	  uses.  Say 'y' if you plan to use the utest, at the expense of having
	  a cluttered #vars.
```

## kern/drivers/net/Kconfig
```kconfig
config BNX2X
	bool "Broadcom BNX2X NIC driver"
	default n
	select ZLIB_INFLATE
	help
	  Broadcom Everest 10 Gb network driver (NetXtremeII).

config BNX2X_SRIOV
	bool "Broadcom SR-IOV"
	depends on BNX2X
	default n
	help
	  BNX2X support for SR-IOV (I/O virtualization).

config MLX4_EN
	tristate "Mellanox Technologies 1/10/40Gbit Ethernet support"
	select MLX4_CORE
	select MLX4_INFINIBAND
	help
	  This driver supports Mellanox Technologies ConnectX Ethernet devices.

config MLX4_CORE
	tristate
	default n

config MLX4_DEFAULT_MGM_LOG_ENTRY_SIZE
	int "Default log mgm size (num of qp per mcg)"
	depends on MLX4_CORE
	default 10
	help
	  To activate device managed flow steering when available, set to -1.

config MLX4_INFINIBAND
	tristate
	default n
```

## kern/lib/Kconfig
```kconfig
menu "Libraries"

config ZLIB_DEFLATE
	bool "Zlib Deflation"
	default y
	help
	  Zlib deflation

config ZLIB_INFLATE
	bool "Zlib Inflation"
	default y
	help
	  Zlib inflation

endmenu
```
