## kern/src/ktest/Kconfig
```kconfig
menu "Testing"

source "kern/src/ktest/Kconfig.kernel"
source "kern/src/ktest/Kconfig.userspace"

endmenu
```

## kern/src/ktest/Kconfig.kernel
```kconfig
menuconfig KERNEL_TESTING
	bool "Kernel testing"
	default n
	help
	  Run unit tests for the kernel

source "kern/src/ktest/Kconfig.postboot"
source "kern/src/ktest/Kconfig.net"

config KTEST_ARENA
	depends on KERNEL_TESTING
	bool "Arena kernel test"
	default y
	help
	Run the arena tests
```

## kern/src/ktest/Kconfig.net
```kconfig
menuconfig NET_KTESTS
	depends on KERNEL_TESTING
	bool "Networking unit tests"
	default y

config TEST_ptclbsum
	depends on NET_KTESTS
	bool "Unit tests for ptclbsum"
	default y

config TEST_simplesum_bench
	depends on NET_KTESTS
	bool "Checksum benchmark: baseline"
	default y

config TEST_ptclbsum_bench
	depends on NET_KTESTS
	bool "Checksum benchmark: ptclbsum"
	default y
```

## kern/src/ktest/Kconfig.postboot
```kconfig
menuconfig PB_KTESTS
    depends on KERNEL_TESTING
    bool "Post-boot kernel tests"
    default y
    help
        Run unit tests after the kernel has booted.

config TEST_ipi_sending
    depends on PB_KTESTS && X86
    bool "IPI sending test"
    default n
    help
        Run the ipi_sending test

config TEST_pic_reception
    depends on PB_KTESTS && X86
    bool "PIC reception test"
    default n
    help
        Run the pic_reception

config TEST_lapic_status_bit
    depends on PB_KTESTS && X86
    bool "LAPIC status bit test"
    default n
    help
        Run the lapic_status_bit

config TEST_pit
    depends on PB_KTESTS && X86
    bool "PIT test"
    default n
    help
        Run the pit test

config TEST_circ_buffer
    depends on PB_KTESTS && X86
    bool "Circular buffer test"
    default n
    help
        Run the circ_buffer test

config TEST_kernel_messages
    depends on PB_KTESTS && X86
    bool "Kernel messages test"
    default n
    help
        Run the kernel_messages test

config TEST_page_coloring
    depends on PB_KTESTS && PAGE_COLORING
    bool "Page coloring test"
    default n
    help
        Run the page_coloring test

config TEST_color_alloc
    depends on PB_KTESTS && PAGE_COLORING
    bool "Color allocation test"
    default n
    help
        Run the color_alloc test

config TEST_barrier
    depends on PB_KTESTS
    bool "Barrier test"
    default n
    help
        Run the barrier test

config TEST_interrupts_irqsave
    depends on PB_KTESTS
    bool "Interrupts irqsave test"
    default y
    help
        Run the interrupts_irqsave test

config TEST_bitmasks
    depends on PB_KTESTS
    bool "Bitmasks test"
    default y
    help
        Run the bitmasks test

config TEST_checklists
    depends on PB_KTESTS
    bool "Checklists test"
    default n
    help
        Run the checklists test

config TEST_smp_call_functions
    depends on PB_KTESTS
    bool "SMP call functions test"
    default n
    help
        Run the smp_call_functions test

config TEST_slab
    depends on PB_KTESTS
    bool "Slab test"
    default n
    help
        Run the slab test

config TEST_kmalloc
    depends on PB_KTESTS
    bool "Kmalloc test"
    default n
    help
        Run the kmalloc test

config TEST_hashtable
    depends on PB_KTESTS
    bool "Hashtable test"
    default y
    help
        Run the hashtable test

config TEST_circular_buffer
    depends on PB_KTESTS
    bool "Circular buffer test"
    default y
    help
        Run the circular buffer test

config TEST_bcq
    depends on PB_KTESTS
    bool "BCQ test"
    default n
    help
        Run the bcq test

config TEST_ucq
    depends on PB_KTESTS
    bool "UCQ test"
    default n
    help
        Run the ucq test

config TEST_vm_regions
    depends on PB_KTESTS
    bool "VM regions test"
    default y
    help
        Run the vm_regions test

config TEST_radix_tree
    depends on PB_KTESTS
    bool "Radix Tree test"
    default y
    help
        Run the radix_tree test

config TEST_random_fs
    depends on PB_KTESTS
    bool "Random FS test"
    default n
    help
        Run the random_fs test

config TEST_kthreads
    depends on PB_KTESTS
    bool "Kthreads test"
    default n
    help
        Run the kthreads test

config TEST_kref
    depends on PB_KTESTS
    bool "Kref test"
    default n
    help
        Run the kref test

config TEST_atomics
    depends on PB_KTESTS
    bool "Atomics test"
    default y
    help
        Run the atomics test

config TEST_abort_halt
    depends on PB_KTESTS
    bool "Abort halt test"
    default n
    help
        Run the abort_halt test

config TEST_cv
    depends on PB_KTESTS
    bool "Condition Variable test"
    default n
    help
        Run the cv test

config TEST_memset
    depends on PB_KTESTS
    bool "Memset test"
    default y
    help
        Run the memset test

config TEST_setjmp
    depends on PB_KTESTS
    bool "Setjmp test"
    default n
    help
        Run the setjmp test

config TEST_apipe
    depends on PB_KTESTS
    bool "Apipe test"
    default n
    help
        Run the apipe test

config TEST_rwlock
    depends on PB_KTESTS
    bool "Rwlock test"
    default n
    help
        Run the rwlock test

config TEST_rv
    depends on PB_KTESTS
    bool "Rendezvous test"
    default n
    help
        Run the rv test

config TEST_alarm
    depends on PB_KTESTS
    bool "Alarm test"
    default n
    help
        Run the alarm test

config TEST_kmalloc_incref
    depends on PB_KTESTS
    bool "Kmalloc incref"
    default n

config TEST_u16pool
    depends on PB_KTESTS
    bool "u16 pool"
    default n

config TEST_uaccess
    depends on PB_KTESTS
    bool "Tests user memory access fault trapping"
    default y

config TEST_sort
    depends on PB_KTESTS
    bool "Tests sort library functions"
    default y

config TEST_cmdline_parse
    depends on PB_KTESTS
    bool "Tests command line parsing functions"
    default y

config TEST_percpu_zalloc
    depends on PB_KTESTS
    bool "percpu dynamic zalloc"
    default y

config TEST_percpu_increment
    depends on PB_KTESTS
    bool "percpu dynamic alloc: increment"
    default y
```

## kern/src/ktest/Kconfig.userspace
```kconfig
menuconfig USERSPACE_TESTING
	bool "User-space testing"
	default n
	help
	  Run userspace unit tests after the kernel has booted.

config USERSPACE_TESTING_SCRIPT
	depends on USERSPACE_TESTING
	string "Path to test launcher script."
	default /bin/tests/utest/runall.sh
	help
	  Run userspace unit tests from the specified path.
```

## kern/src/net/Kconfig
```kconfig
menuconfig NETWORKING
	bool "Networking Support"
	default y
	help
	  This is a placeholder for networking related option.  Right now,
	  CONFIG_NETWORKING does not change the build in any way.

if NETWORKING

endif # NETWORKING
```
